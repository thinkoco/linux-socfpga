## arch/arm/configs/de1_soc_defconfig
```kconfig
CONFIG_DEFAULT_HOSTNAME="knat"
CONFIG_SYSVIPC=y
CONFIG_FHANDLE=y
# CONFIG_USELIB is not set
CONFIG_HIGH_RES_TIMERS=y
CONFIG_IKCONFIG=y
CONFIG_IKCONFIG_PROC=y
CONFIG_LOG_BUF_SHIFT=14
CONFIG_CGROUPS=y
CONFIG_CPUSETS=y
CONFIG_NAMESPACES=y
CONFIG_BLK_DEV_INITRD=y
CONFIG_EMBEDDED=y
CONFIG_PROFILING=y
CONFIG_OPROFILE=y
CONFIG_MODULES=y
CONFIG_MODULE_UNLOAD=y
# CONFIG_BLK_DEV_BSG is not set
# CONFIG_IOSCHED_DEADLINE is not set
# CONFIG_IOSCHED_CFQ is not set
CONFIG_ARCH_SOCFPGA=y
CONFIG_SOCFPGA_SUSPEND=y
CONFIG_ARM_THUMBEE=y
CONFIG_PL310_ERRATA_753970=y
# CONFIG_ARM_ERRATA_643719 is not set
CONFIG_SMP=y
CONFIG_VMSPLIT_2G=y
CONFIG_NR_CPUS=2
CONFIG_AEABI=y
CONFIG_OABI_COMPAT=y
CONFIG_CMA=y
CONFIG_CMA_DEBUG=y
CONFIG_ZBOOT_ROM_TEXT=0x0
CONFIG_ZBOOT_ROM_BSS=0x0
CONFIG_VFP=y
CONFIG_NEON=y
CONFIG_NET=y
CONFIG_PACKET=y
CONFIG_UNIX=y
CONFIG_NET_KEY=y
CONFIG_NET_KEY_MIGRATE=y
CONFIG_INET=y
CONFIG_IP_MULTICAST=y
CONFIG_IP_PNP=y
CONFIG_IP_PNP_DHCP=y
CONFIG_IP_PNP_BOOTP=y
CONFIG_IP_PNP_RARP=y
CONFIG_IPV6=y
CONFIG_NETWORK_PHY_TIMESTAMPING=y
CONFIG_VLAN_8021Q=y
CONFIG_VLAN_8021Q_GVRP=y
CONFIG_CAN=y
CONFIG_CAN_C_CAN=y
CONFIG_CAN_C_CAN_PLATFORM=y
CONFIG_CAN_DEBUG_DEVICES=y
CONFIG_CFG80211=y
CONFIG_MAC80211=y
CONFIG_MAC80211_MESH=y
CONFIG_UEVENT_HELPER_PATH="/sbin/hotplug"
CONFIG_DEVTMPFS=y
CONFIG_DEVTMPFS_MOUNT=y
CONFIG_DMA_CMA=y
CONFIG_CMA_SIZE_MBYTES=512
# CONFIG_ARM_CCI400_PMU is not set
CONFIG_ARM_CCN=y
CONFIG_VEXPRESS_CONFIG=y
CONFIG_MTD=y
CONFIG_MTD_BLOCK=y
CONFIG_MTD_NAND=y
CONFIG_MTD_NAND_DENALI=y
CONFIG_MTD_NAND_DENALI_DT=y
CONFIG_BLK_DEV_RAM=y
CONFIG_BLK_DEV_RAM_COUNT=2
CONFIG_BLK_DEV_RAM_SIZE=8192
CONFIG_SRAM=y
CONFIG_ALTERA_STAPL=y
CONFIG_SCSI=y
# CONFIG_SCSI_PROC_FS is not set
CONFIG_BLK_DEV_SD=y
# CONFIG_SCSI_LOWLEVEL is not set
CONFIG_NETDEVICES=y
CONFIG_ALTERA_TSE=y
CONFIG_STMMAC_ETH=y
CONFIG_MICREL_PHY=y
CONFIG_FIXED_PHY=y
CONFIG_USB_USBNET=y
CONFIG_RTL8187=y
CONFIG_RT2X00=y
CONFIG_RT2800USB=y
CONFIG_RT2800USB_RT53XX=y
CONFIG_RTL8192CU=y
# CONFIG_RTLWIFI_DEBUG is not set
CONFIG_INPUT_EVDEV=y
CONFIG_INPUT_TOUCHSCREEN=y
CONFIG_TOUCHSCREEN_STMPE=y
# CONFIG_SERIO_SERPORT is not set
CONFIG_SERIO_AMBAKMI=y
CONFIG_LEGACY_PTY_COUNT=16
CONFIG_SERIAL_8250=y
CONFIG_SERIAL_8250_CONSOLE=y
CONFIG_SERIAL_8250_NR_UARTS=2
CONFIG_SERIAL_8250_RUNTIME_UARTS=2
CONFIG_SERIAL_8250_DW=y
CONFIG_I2C_CHARDEV=y
CONFIG_I2C_DESIGNWARE_PLATFORM=y
CONFIG_SPI=y
CONFIG_SPI_DESIGNWARE=y
CONFIG_SPI_DW_MMIO=y
CONFIG_SPI_SPIDEV=y
CONFIG_GPIOLIB=y
CONFIG_GPIO_SYSFS=y
CONFIG_GPIO_ALTERA=m
CONFIG_GPIO_DWAPB=y
CONFIG_PMBUS=y
CONFIG_SENSORS_LTC2978=y
CONFIG_SENSORS_LTC2978_REGULATOR=y
CONFIG_WATCHDOG=y
CONFIG_DW_WATCHDOG=y
CONFIG_MFD_STMPE=y
CONFIG_REGULATOR=y
CONFIG_REGULATOR_FIXED_VOLTAGE=y
CONFIG_MEDIA_SUPPORT=y
CONFIG_MEDIA_CAMERA_SUPPORT=y
CONFIG_MEDIA_CONTROLLER=y
CONFIG_VIDEO_V4L2_SUBDEV_API=y
CONFIG_VIDEO_FIXED_MINOR_RANGES=y
CONFIG_MEDIA_USB_SUPPORT=y
CONFIG_USB_VIDEO_CLASS=y
CONFIG_USB_GSPCA=y
CONFIG_USB_GSPCA_ZC3XX=y
CONFIG_FB=y
CONFIG_FB_ALTERA_VIP=y
CONFIG_BACKLIGHT_LCD_SUPPORT=y
CONFIG_FRAMEBUFFER_CONSOLE=y
CONFIG_FRAMEBUFFER_CONSOLE_DETECT_PRIMARY=y
CONFIG_FRAMEBUFFER_CONSOLE_ROTATION=y
CONFIG_LOGO=y
CONFIG_SOUND=y
CONFIG_SND=y
CONFIG_SND_SEQUENCER=y
CONFIG_SND_SEQ_DUMMY=y
CONFIG_SND_MIXER_OSS=y
CONFIG_SND_PCM_OSS=y
CONFIG_SND_SEQUENCER_OSS=y
CONFIG_SND_HRTIMER=y
CONFIG_SND_DYNAMIC_MINORS=y
CONFIG_SND_SOC=y
CONFIG_SND_DESIGNWARE_I2S=y
CONFIG_SND_SOC_WM8731=m
CONFIG_SND_SIMPLE_CARD=y
CONFIG_SOUND_PRIME=y
CONFIG_USB=y
CONFIG_USB_ANNOUNCE_NEW_DEVICES=y
CONFIG_USB_OTG=y
CONFIG_USB_XHCI_HCD=y
CONFIG_USB_EHCI_HCD=y
CONFIG_USB_EHCI_HCD_PLATFORM=y
CONFIG_USB_OHCI_HCD=y
CONFIG_USB_OHCI_HCD_PLATFORM=y
CONFIG_USB_WDM=y
CONFIG_USB_STORAGE=y
CONFIG_USB_DWC3=y
CONFIG_USB_DWC3_HOST=y
CONFIG_USB_DWC2=y
CONFIG_USB_DWC2_HOST=y
CONFIG_USB_SERIAL=y
CONFIG_USB_SERIAL_GENERIC=y
CONFIG_USB_SERIAL_CH341=y
CONFIG_USB_SERIAL_CP210X=y
CONFIG_USB_SERIAL_FTDI_SIO=y
CONFIG_USB_SERIAL_PL2303=y
CONFIG_NOP_USB_XCEIV=y
CONFIG_USB_GADGET=y
CONFIG_MMC=y
CONFIG_MMC_DW=y
CONFIG_DMADEVICES=y
CONFIG_GENERIC_PHY=y
CONFIG_FPGA=y
CONFIG_FPGA_REGION=y
CONFIG_FPGA_MGR_SOCFPGA=y
CONFIG_FPGA_BRIDGE=y
CONFIG_SOCFPGA_FPGA_BRIDGE=y
CONFIG_ALTERA_FREEZE_BRIDGE=y
CONFIG_ALTERA_OPENCL=m
CONFIG_FIRMWARE_MEMMAP=y
CONFIG_EXT2_FS=y
CONFIG_EXT2_FS_XATTR=y
CONFIG_EXT2_FS_POSIX_ACL=y
CONFIG_EXT3_FS=y
CONFIG_EXT4_FS=y
CONFIG_AUTOFS4_FS=y
CONFIG_VFAT_FS=y
CONFIG_NTFS_FS=y
CONFIG_NTFS_RW=y
CONFIG_TMPFS=y
CONFIG_CONFIGFS_FS=y
CONFIG_JFFS2_FS=y
CONFIG_NFS_FS=y
CONFIG_ROOT_NFS=y
CONFIG_NLS_CODEPAGE_437=y
CONFIG_NLS_CODEPAGE_936=y
CONFIG_NLS_ISO8859_1=y
CONFIG_PRINTK_TIME=y
CONFIG_DEBUG_INFO=y
CONFIG_MAGIC_SYSRQ=y
CONFIG_DETECT_HUNG_TASK=y
# CONFIG_SCHED_DEBUG is not set
CONFIG_ENABLE_DEFAULT_TRACERS=y
CONFIG_DEBUG_USER=y
CONFIG_CRYPTO_ECB=y
CONFIG_CRYPTO_MICHAEL_MIC=y
CONFIG_CRYPTO_SHA256=m
# CONFIG_CRYPTO_ANSI_CPRNG is not set
CONFIG_CRYPTO_DRBG_MENU=m
```

## drivers/fpga/Kconfig
```kconfig
#
# FPGA framework configuration
#

menu "FPGA Configuration Support"

config FPGA
	tristate "FPGA Configuration Framework"
	help
	  Say Y here if you want support for configuring FPGAs from the
	  kernel.  The FPGA framework adds a FPGA manager class and FPGA
	  manager drivers.

config FPGA_MGR_DEBUG_FS
       bool "FPGA Manager DebugFS"
       depends on FPGA && DEBUG_FS
       help
         Say Y here if you want to expose a DebugFS interface for the
	 FPGA Manager Framework.

if FPGA

config FPGA_REGION
       bool "FPGA Region"
       depends on OF
       help
	 FPGA Regions allow loading FPGA images under control of
	 the Device Tree.

config FPGA_MGR_SOCFPGA
	tristate "Altera SOCFPGA FPGA Manager"
	depends on ARCH_SOCFPGA
	help
	  FPGA manager driver support for Altera SOCFPGA.

config FPGA_MGR_SOCFPGA_A10
	tristate "Altera SoCFPGA Arria10"
	depends on ARCH_SOCFPGA
	help
	  FPGA manager driver support for Altera Arria10 SoCFPGA.

config FPGA_BRIDGE
       bool "FPGA Bridge Framework"
       depends on OF
       help
         Say Y here if you want to support bridges connected between host
	 processors and FPGAs or between FPGAs.

config SOCFPGA_FPGA_BRIDGE
	bool "Altera SoCFPGA FPGA Bridges"
	depends on ARCH_SOCFPGA && FPGA_BRIDGE
	help
	  Say Y to enable drivers for FPGA bridges for Altera SOCFPGA
	  devices.

config ALTERA_FREEZE_BRIDGE
        bool "Altera FPGA Freeze Bridge"
	depends on ARCH_SOCFPGA && FPGA_BRIDGE
	help
	  Say Y to enable drivers for Altera FPGA Freeze bridges.  A
	  freeze bridge is a bridge that exists in the FPGA fabric to
	  isolate one region of the FPGA from the busses while that
	  region is being reprogrammed.

#comment "IntelFPGA Cyclone V OpenCL module"
choice
	prompt "Choose One of IntelFPGA OpenCL Driver"
	default ALTERA_OPENCL_161

	config ALTERA_OPENCL_141
		tristate "Altera SocFPGA OpenCL Driver 14.1"
		select ALTERA_STAPL
		help
		  Say Y here if you want support for oepncl from the
		  kernel.  The altera opencl drivers.

	config ALTERA_OPENCL_160
		tristate "Altera SocFPGA OpenCL Driver 16.0"
		select ALTERA_STAPL
		help
		  Say Y here if you want support for oepncl from the
		  kernel.  The altera opencl drivers.

	config ALTERA_OPENCL_161
		tristate "Altera SocFPGA OpenCL Driver 16.1"
		select ALTERA_STAPL 
		help
		  Say Y here if you want support for oepncl from the
		  kernel.  The altera opencl drivers.


	config INTELFPGA_CYCLONE_V_OPENCL_170
		tristate "IntelFPGA Cyclone V OpenCL Driver 17.0"
		select ALTERA_STAPL
		help
		  Say Y here if you want support for oepncl from the
		  kernel.  The altera opencl drivers.

	config INTELFPGA_ARRIA_10_OPENCL_170
		tristate "IntelFPGA Arria 10 OpenCL Driver 17.0"
		select ALTERA_STAPL
		select FPGA_MGR_SOCFPGA_A10
		help
		  Say Y here if you want support for oepncl from the
		  kernel.  The altera opencl drivers.

	config INTELFPGA_CYCLONE_V_OPENCL_171
		tristate "IntelFPGA Cyclone V OpenCL Driver 17.1"
		select ALTERA_STAPL
		help
		  Say Y here if you want support for oepncl from the
		  kernel.  The altera opencl drivers.

	config INTELFPGA_ARRIA_10_OPENCL_171
		tristate "IntelFPGA Arria 10 OpenCL Driver 17.1"
		select ALTERA_STAPL
		select FPGA_MGR_SOCFPGA_A10
		help
		  Say Y here if you want support for oepncl from the
		  kernel.  The altera opencl drivers.


endchoice





#source "drivers/fpga/aclsoc_drv_14.1/Kconfig"
#source "drivers/fpga/aclsoc_drv_16.0/Kconfig"
#source "drivers/fpga/aclsoc_drv_16.1/Kconfig"
#source "drivers/fpga/c5soc_drv_17.0/Kconfig"
#source "drivers/fpga/a10soc_drv_17.0/Kconfig"
#source "drivers/fpga/c5soc_drv_17.1/Kconfig"
#source "drivers/fpga/a10soc_drv_17.1/Kconfig"

endif # FPGA

endmenu
```

## drivers/fpga/a10soc_drv_17.0/Kconfig
```kconfig
config INTELFPGA_ARRIA_10_OPENCL_170
	tristate "IntelFPGA Arria 10 OpenCL Driver 17.0"
	select ALTERA_STAPL
	default n
	help
	  Say Y here if you want support for oepncl from the
	  kernel.  The altera opencl drivers.
```

## drivers/fpga/aclsoc_drv/Kconfig
```kconfig
comment "Altera soc OpenCL module"

config ALTERA_OPENCL
	tristate "Altera OpenCL DE1_SOC"
	depends on ALTERA_STAPL
	default n
	help
	  Say Y here if you want support for oepncl from the
	  kernel.  The altera opencl drivers.
```

## drivers/fpga/aclsoc_drv_14.1/Kconfig
```kconfig
config ALTERA_OPENCL_141
	tristate "Altera SocFPGA OpenCL Driver 14.1"
	selsect ALTERA_STAPL
	default n
	help
	  Say Y here if you want support for oepncl from the
	  kernel.  The altera opencl drivers.
```

## drivers/fpga/aclsoc_drv_16.0/Kconfig
```kconfig
config ALTERA_OPENCL_160
	tristate "Altera SocFPGA OpenCL Driver 16.0"
	selsect ALTERA_STAPL
	default n
	help
	  Say Y here if you want support for oepncl from the
	  kernel.  The altera opencl drivers.
```

## drivers/fpga/aclsoc_drv_16.1/Kconfig
```kconfig
config ALTERA_OPENCL_161
	tristate "Altera SocFPGA OpenCL Driver 16.1"
	depends on ALTERA_STAPL
	default n
	help
	  Say Y here if you want support for oepncl from the
	  kernel.  The altera opencl drivers.
```

## drivers/fpga/c5soc_drv_17.0/Kconfig
```kconfig
config INTELFPGA_CYCLONE_V_OPENCL_170
	tristate "IntelFPGA Cyclone V OpenCL Driver 17.0"
	depends on ALTERA_STAPL
	default n
	help
	  Say Y here if you want support for oepncl from the
	  kernel.  The altera opencl drivers.
```

## drivers/fpga/c5soc_drv_17.1/Kconfig
```kconfig
config INTELFPGA_CYCLONE_V_OPENCL_171
	tristate "IntelFPGA Cyclone V OpenCL Driver 17.1"
	depends on ALTERA_STAPL
	default n
	help
	  Say Y here if you want support for oepncl from the
	  kernel.  The altera opencl drivers.
```

## sound/soc/de1_soc_audio/Kconfig
```kconfig
config SND_SOC_DE1SOC
	tristate "DE1SOC Audio "
	help
	  Enable support for DE1SOC Audio WM8731 & opencores I2S.
```
